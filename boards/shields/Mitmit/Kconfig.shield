## boards/shields/Mitmit/Kconfig.shield
```kconfig
# No whitespace after the comma or in your part name!
config SHIELD_MITMIT_LEFT
    def_bool $(shields_list_contains,Mitmit_left)

# No whitespace after the comma or in your part name!
config SHIELD_MITMIT_RIGHT
    def_bool $(shields_list_contains,Mitmit_right)

CONFIG_ZMK_SOFT_OFF=y
```

## config/west.yml
```yaml
manifest:
  remotes:
    - name: Haha1609
      url-base: https://github.com/Haha1609  
    - name: inorichi
      url-base: https://github.com/charlesmst # fork of inorichi

  projects:
    - name: zmk
      remote: Haha1609
      revision: feat/pointers-move-scroll
      import: app/west.yml

    - name: zmk-pmw3610-driver
      remote: inorichi
      revision: main
      
  self:
    path: config
```
